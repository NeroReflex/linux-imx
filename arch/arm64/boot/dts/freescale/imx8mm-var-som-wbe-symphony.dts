// SPDX-License-Identifier: (GPL-2.0+ OR MIT)
/*
 * Copyright 2018 NXP
 * Copyright 2019-2025 Variscite Ltd.
 */

#include "imx8mm-var-som-symphony.dts"

/ {
	model = "Variscite VAR-SOM-MX8M-MINI M4 on Symphony-Board 1.4a and above";
};
